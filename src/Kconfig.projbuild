## src/Kconfig.projbuild
```kconfig
menu "Example Configuration"

config ROUTER_SSID
    string "Router SSID"
        default "ROUTER_SSID"
        help
            Router SSID.

config ROUTER_PASSWORD
    string "Router password"
        default "ROUTER_PASSWORD"
        help
            Router password.

config SERVER_IP
    string "Server IP address"
        default "10.0.0.133"
        help
            Server IP address.

config SERVER_PORT
    int "Server port"
        default "666"
        help
            Server port.

endmenu
```
